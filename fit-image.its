## fit-image.its
```
/dts-v1/;
/ {
    description = "RK3328 ROC-PC FIT Image";
    #address-cells = <1>;
    #size-cells = <0>;

    images {
        kernel@1 {
            description = "RK3328 Kernel Image";
            data = /incbin/("./arch/arm64/boot/Image");
            arch = "arm64";
            os = "linux";
            type = "kernel";
            compression = "none";
            load = <0x02080000>;
            entry = <0x02080000>;
        };

        fdt@2 {
            description = "Device Tree Blob for RK3328 ROC-PC";
            data = /incbin/("./arch/arm64/boot/dts/rockchip/rk3328-orangepi-r1-plus.dtb");
            type = "flat_dt";
            arch = "arm64";
            compression = "none";
            load = <0x01f00000>;
        };
    };

    configurations {
        default = "config@1";
        config@1 {
            kernel = "kernel@1";
            fdt = "fdt@2";
        };
    };
};
```
